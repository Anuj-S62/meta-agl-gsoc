## meta-agl-gsoc/conf/layer.conf
```bitbake
# We have a conf and classes directory, add to BBPATH
BBPATH .= ":${LAYERDIR}"

# We have recipes-* directories, add to BBFILES
BBFILES += "${LAYERDIR}/recipes-*/*/*.bb \
            ${LAYERDIR}/recipes-*/*/*.bbappend"

BBFILE_COLLECTIONS += "meta-agl-gsoc"
BBFILE_PATTERN_meta-agl-gsoc = "^${LAYERDIR}/"
BBFILE_PRIORITY_meta-agl-gsoc = "65"

LAYERDEPENDS_meta-agl-gsoc = "core"
LAYERSERIES_COMPAT_meta-agl-gsoc = "kirkstone"

BBFILES_DYNAMIC += " \
    agldemo:${LAYERDIR}/dynamic-layers/meta-agl-demo/*/*/*.bb \
    agldemo:${LAYERDIR}/dynamic-layers/meta-agl-demo/*/*/*.bbappend \
"
```
